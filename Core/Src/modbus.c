#include "main.h"

u8	modbus_Tx_buff[100];		//发送缓冲区
u16 modbus_virtual_register[10]={1,2,3,4,5,6,7,8,9,0}; //虚拟寄存器


/* 发送数据函数，buff为发送内容，len表示发送字节数 */
void modbus_send_data(u8 *buff,u8 len)
{
	for(u8 i=0;i<len;i++)
	{
		uart2_send((uint8_t )(*(buff + i)));
	}	
}

/* modbus服务函数 */
void modbus_service(void)
{
	//uart2_send('A');
	u16 data_CRC_value=0;   		//从机收到的CRC校验码
	u16 data_len=0;         		//从机收到的modbus数据长度
	u16 CRC_check_result=0; 		//从机根据收到的数据计算出来的CRC校验码
	if(USART2_RX_STA&0x8000)  //串口接收完成的标志
	{
		data_len = USART2_RX_STA & 0x3fff;
		#if(DEBUG_MODBUS) 
			rt_kprintf("modbusrecvdata=\r\n");
			for(u8 i=0;i<data_len;i++)
			{
				rt_kprintf("%02X ",USART2_RX_BUF[i]);
			}
			rt_kprintf("\r\n");
		#endif
		CRC_check_result = CRC_16_check(USART2_RX_BUF,data_len-2);
			//rt_kprintf("CRC_check_result=%0X\r\n",CRC_check_result);
		data_CRC_value=USART2_RX_BUF[data_len-1]|(((u16)USART2_RX_BUF[data_len-2])<<8); //高位在前 低位在后，两字节组成一个u16型
			//rt_kprintf("data_CRC_value=%0X\r\n",data_CRC_value);
		if(CRC_check_result==data_CRC_value)
		{
			if(USART2_RX_BUF[0]==MODBUS_SLAVE_ADDR)
			{
				switch(USART2_RX_BUF[1])
				{
					case 0x03:     //读多个寄存器
					{
						//rt_kprintf("modbus_03_function()\r\n");
						modbus_03_function();
						break;
					}
					case 0x06:      //写单个寄存器
					{
						break;
					}
					case 0x0F:      //写多个寄存器
					{
						break;
					}
				}
			}
		}
		USART2_RX_STA=0;  //开始下一次接收
	}
}

//读保持寄存器
void modbus_03_function(void)
{
	//u16 i;
	//u16 arr_start=0x03;   			//从机回复寄存器的值是从数组的第3位开始
	u16 register_len;  			//查询寄存器的数量
	u16 register_start;			//查询寄存器的起始地址
	u16 sendCRC=0;
	
	u16 currentValue=abs(syspara.current);
	
	modbus_Tx_buff[0] = MODBUS_SLAVE_ADDR;
	modbus_Tx_buff[1] = 0x03;
	register_len = USART2_RX_BUF[5]|(((u16)USART2_RX_BUF[4])<<8);   //高位在前 低位在后，两字节组成一个u16型
	modbus_Tx_buff[2] = register_len;
	register_start = USART2_RX_BUF[3]|(((u16)USART2_RX_BUF[2])<<8);
	
	uint8_t readRegBuff[100]={0};
	
	if(RT_EOK == rt_mutex_take(SH_mutex,100))
	{
			
		if((register_start==0x40) && (register_len==0x34))		//从40H开始读52个寄存器(寄存器只有51个,第52个虚拟为SOC)
		{
			SH367309_ReadRegVal(register_start,readRegBuff,register_len-1);
			for(u8 i=0;i<register_len-1;i++)
			{
				//rt_kprintf("readRegBuff[%X]=%02X\r\n",i+0x40,readRegBuff[i]);
				modbus_Tx_buff[i+3]=readRegBuff[i];
			}
			modbus_Tx_buff[0x2E+3]=currentValue>>8;		//直接将电流复制到寄存器上
			modbus_Tx_buff[0x2F+3]=currentValue&0xFF;
			modbus_Tx_buff[register_len+2]=syspara.SOC;		//将最后一个多出的寄存器赋值为SOC值
		}else
		{
			SH367309_ReadRegVal(register_start,readRegBuff,register_len);
			for(u8 i=0;i<register_len;i++)
			{
				//rt_kprintf("readRegBuff[%X]=%02X\r\n",i+0x40,readRegBuff[i]);
				modbus_Tx_buff[i+3]=readRegBuff[i];
			}
		}
		
		rt_mutex_release(SH_mutex);
		
		sendCRC=CRC_16_check(modbus_Tx_buff,register_len+3);
		modbus_Tx_buff[register_len+3]=(sendCRC>>8)&0xFF;         
		modbus_Tx_buff[register_len+4]=(sendCRC)&0xFF;

#if(DEBUG_MODBUS)
	rt_kprintf("modbus_Tx_buff=\r\n");
	for(u8 i=0;i<register_len+5;i++)
	{
		rt_kprintf("%02X ",modbus_Tx_buff[i]);
	}
	rt_kprintf("\r\n");
#endif
		modbus_send_data(modbus_Tx_buff,register_len+5);
	
	}
//	for(i=0;i<register_len;i++,register_start++)
//	{
//		modbus_Tx_buff[arr_start]=modbus_virtual_register[register_start]>>8&0xFF;         
//		arr_start++;
//		modbus_Tx_buff[arr_start]=modbus_virtual_register[register_start]&0xFF;
//		arr_start++;
//	}
//	arr_start=CRC_16_check(modbus_Tx_buff,register_start*2+3);
//	modbus_Tx_buff[register_start*2+3]=(arr_start>>8)&0xFF;         
//	modbus_Tx_buff[register_start*2+4]=(arr_start)&0xFF;
//	modbus_send_data(modbus_Tx_buff,register_start*2+5);
}


u16 CRC_16_check(unsigned char *ptr,  unsigned char len)
{ 
	uint16_t index;
	uint8_t crcl = 0xFF; 
	uint8_t crch = 0xFF;
	uint8_t TabH[] = {  
		0x00, 0xC1, 0x81, 0x40, 0x01, 0xC0, 0x80, 0x41, 0x01, 0xC0,  
		0x80, 0x41, 0x00, 0xC1, 0x81, 0x40, 0x01, 0xC0, 0x80, 0x41,  
		0x00, 0xC1, 0x81, 0x40, 0x00, 0xC1, 0x81, 0x40, 0x01, 0xC0,  
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		0x80, 0x41, 0x00, 0xC1, 0x81, 0x40  
	} ;  
	u8 TabL[] = {  
		0x00, 0xC0, 0xC1, 0x01, 0xC3, 0x03, 0x02, 0xC2, 0xC6, 0x06,  
		0x07, 0xC7, 0x05, 0xC5, 0xC4, 0x04, 0xCC, 0x0C, 0x0D, 0xCD,  
		0x0F, 0xCF, 0xCE, 0x0E, 0x0A, 0xCA, 0xCB, 0x0B, 0xC9, 0x09,  
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		0x43, 0x83, 0x41, 0x81, 0x80, 0x40  
	} ;
	
	while (len--)  
	{
		index = crcl ^ *ptr++;
		crcl = crch ^ TabH[index];
		crch = TabL[index];
	}
	return ((crcl<<8) | crch);  
} 

